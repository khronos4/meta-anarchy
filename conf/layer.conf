## conf/layer.conf
```bitbake
BBPATH .= ":${LAYERDIR}"

BBFILES += "${LAYERDIR}/recipes-*/*/*.bb ${LAYERDIR}/recipes-*/*/*.bbappend"

BBFILE_COLLECTIONS += "anarchy-layer"
BBFILE_PATTERN_anarchy-layer := "^${LAYERDIR}/"

BBFILE_PRIORITY_anarchy-layer = "8"

LICENSE_PATH += "${LAYERDIR}/licenses"
```
